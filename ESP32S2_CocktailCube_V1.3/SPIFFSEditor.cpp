/*
 * Includes all spiffs editor functions
 *
 * @author    Florian Stäblein
 * @date      2025/01/01
 * @copyright © 2025 Florian Stäblein
 */

//===============================================================
// Includes
//===============================================================
#include "SPIFFSEditor.h"

//===============================================================
// Constants
//===============================================================
static const char* TAG = "spiffseditor";

//===============================================================
// Defines
//===============================================================
#define edit_html_gz_len              7701

//===============================================================
// https://mischianti.org/online-converter-file-to-cpp-gzip-byte-array-3/
// File: edit.html.gz, Size: 7701
//===============================================================
const uint8_t edit_html_gz[] PROGMEM =
{
  0x1F, 0x8B, 0x08, 0x00, 0x00, 0x00, 0x00, 0x00, 0x00, 0x03, 0xD5, 0x7C, 0xE9, 0x72, 0xE3, 0x46, 
  0xB6, 0xE6, 0x6F, 0x3B, 0xC2, 0xEF, 0x00, 0xD3, 0xD3, 0x5D, 0x54, 0x53, 0x12, 0x40, 0x82, 0xAB, 
  0xAA, 0x64, 0x37, 0xC0, 0x0D, 0xDC, 0x37, 0x70, 0xF5, 0xF5, 0xBD, 0x81, 0x25, 0x41, 0x80, 0xC4, 
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  0x18, 0x61, 0x4B, 0x00, 0x00
};

//===============================================================
// Constructor
//===============================================================
SPIFFSEditor::SPIFFSEditor()
{
}

//===============================================================
// Returns true, if the handler can handle the request
//===============================================================
bool SPIFFSEditor::canHandle(WebServer &server, HTTPMethod method, const String &uri)
{
  // Check for URL '/edit'
  bool canHandle = uri.equalsIgnoreCase("/edit");
  ESP_LOGE(TAG, "Can handle request from '/edit'? %s", canHandle ? "✓" : "✖");
  return canHandle;
}

//===============================================================
// Returns true if the handler can upload the file
//===============================================================
bool SPIFFSEditor::canUpload(WebServer &server, const String &uri)
{
  // Check for URL '/edit'
  bool canUpload = uri.equalsIgnoreCase("/edit");
  ESP_LOGE(TAG, "Can handle upload from '/edit'? %s", canUpload ? "✓" : "✖");
  return canUpload;
}

//===============================================================
// Handles the request
//===============================================================
bool SPIFFSEditor::handle(WebServer &server, HTTPMethod method, const String &requestUri)
{
  ESP_LOGI(TAG, "Handle: request=%s", requestUri.c_str());

  if (method == HTTP_GET)
  {
    if (server.argName(0) == "list")
    {
      ESP_LOGI(TAG, "Handle GET 'list'");

      // Open directory
      File dir = SPIFFS.open(server.arg(0), FILE_READ);
      String output = "[";

      // Open first file
      File entry = dir.openNextFile();

      // Iterate through all files
      while (entry)
      {
        if (output != "[")
        {
          output += ',';
        }
        output += "{\"type\":\"file\",\"name\":\"";
        output += String(entry.name());
        output += "\",\"size\":";
        output += String(entry.size());
        output += "}";

        entry = dir.openNextFile();
      }

      dir.close();

      output += "]";
      server.send(200, "application/json", output);
      output = String();

      ESP_LOGI(TAG, "GET: Retrieving file list successful");
      return true;
    }
    else if (server.argName(0) == "download")
    {
      ESP_LOGI(TAG, "Handle GET 'download'");

      // Check if file exists
      if (!SPIFFS.exists(server.arg(0)))
      {
        ESP_LOGE(TAG, "GET: Error downloading file, file missing");
        server.send(404, "text/plain; charset=utf-8", "GET: Error downloading file, file missing");
        return false;
      }

      // Open file
      File file = SPIFFS.open(server.arg(0), FILE_READ);

      // Get file name with extension and send as header
      String fileName = server.arg(0);
      int16_t lastSlashIndex = fileName.lastIndexOf('/');
      if (lastSlashIndex != -1)
      {
        fileName = fileName.substring(lastSlashIndex + 1);
      }
      server.sendHeader("Content-Disposition", "attachment; filename=\"" + fileName + "\"");

      // Stream file
      server.streamFile(file, "application/octet-stream");
      file.close();

      ESP_LOGI(TAG, "GET: Downloading file successful");
      return true;
    }
    
    // Send '/edit.html'
    ESP_LOGI(TAG, "Handle GET edit page");
    server.sendHeader("Content-Encoding", "gzip");
    server.send_P(200, "text/html", (const char*)edit_html_gz, edit_html_gz_len);
    return true;
  }
  else if (method == HTTP_DELETE)
  {
    ESP_LOGI(TAG, "Handle DELETE");

    // Check for path param
    if (server.argName(0) != "path")
    {
      ESP_LOGE(TAG, "DELETE: Error deleting file, path parameter missing");
      server.send(404, "text/plain; charset=utf-8", "DELETE: Error deleting file, path parameter missing");
      return false;
    }

    // Delete file from file system
    if (!SPIFFS.remove(server.arg(0)))
    {
      ESP_LOGE(TAG, "DELETE: Error deleting file, SPIFFS error");
      server.send(404, "text/plain; charset=utf-8", "DELETE: Error deleting file, SPIFFS error");
      return false;
    }

    ESP_LOGI(TAG, "DELETE: %s successful.", server.arg("path").c_str());
    server.send(200, "text/plain; charset=utf-8", "DELETE: " + server.arg("path") + " successful.");
    return true;
  }
  else if (method == HTTP_POST)
  {
    // Check for upload success
    if (_uploadSuccess == false)
    {
      ESP_LOGE(TAG, "UPLOAD: Error uploading file '%s'!", _fileName.c_str());
      server.send(500, "text/plain; charset=utf-8", "UPLOAD: Error uploading file '" + _fileName + "'!");
      _fileName = String();
      return false;
    }

    // Was all done in upload function
    ESP_LOGI(TAG, "UPLOAD: Uploading '%s' successful.", _fileName.c_str());
    server.send(200, "text/plain", "UPLOAD: " + _fileName + " successful.");
    _uploadSuccess = false;
    _fileName = String();
    return true;
  }
  
  ESP_LOGE(TAG, "Unknown HTTP method!");
  server.send(404, "text/plain; charset=utf-8", "Unknown HTTP method!");
  return false;
}

//===============================================================
// Handles the upload
//===============================================================
void SPIFFSEditor::upload(WebServer &server, const String &requestUri, HTTPUpload &upload)
{
  if (upload.status == UPLOAD_FILE_START)
  {
    _fileName = upload.filename;
    ESP_LOGI(TAG, "Start uploading file '%s'", _fileName.c_str());

    // Remove file if existing
    if (SPIFFS.exists(_fileName))
    {
      ESP_LOGI(TAG, "Remove existing file");
      SPIFFS.remove(_fileName);
    }

    // Open the file for writing
    ESP_LOGI(TAG, "Open the file for writing");
    _fsUploadFile = SPIFFS.open(_fileName, FILE_WRITE);
    _uploadSuccess = false;
  }
  else if (upload.status == UPLOAD_FILE_WRITE)
  {
    size_t written = 0;
    if (_fsUploadFile)
    {
      // Write received bytes
      written = _fsUploadFile.write(upload.buf, upload.currentSize);
      if (written < upload.currentSize)
      {
        // Upload failed
        _fsUploadFile.close();
        ESP_LOGE(TAG, "Error uploading file!");

        // Delete file to free up space in filesystem
        SPIFFS.remove(_fileName);
        return;
      }
    }

    ESP_LOGI(TAG, "SPIFFS free: %d of %d", SPIFFS.usedBytes(), SPIFFS.totalBytes());
    ESP_LOGI(TAG, "SPIFFS written: %d of %d", written, upload.currentSize);
    ESP_LOGI(TAG, "SPIFFS totalSize: %d", upload.currentSize + upload.totalSize);
  }
  else if (upload.status == UPLOAD_FILE_END)
  {
    // Close the file
    if (_fsUploadFile)
    {
      _fsUploadFile.close();
      _uploadSuccess = true;
      ESP_LOGI(TAG, "Upload finished: %d bytes uploaded", upload.totalSize);
    }
  }
}
